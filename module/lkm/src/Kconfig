## module/lkm/src/Kconfig
```kconfig
# SPDX-License-Identifier: GPL-2.0-only

menu "nuke ext4 sysfs"

config NUKE_EXT4_SYSFS
	tristate "nuke ex4 sysfs"
	default m
	depends on MODULES
	help
	  this LKM unregisters an ext4 sysfs node given with mount point.
	  Usage:
	     "insmod nuke_sysfs.ko mount_point=/data/adb/modules symaddr=0xfffff12345"

endmenu
```

## module/vfs/src/Kconfig
```kconfig
# SPDX-License-Identifier: GPL-2.0-only
#
# Kconfig for the Hybrid Mount VFS kernel subsystem (`hybridmount`)

config HYBRIDMOUNT
	tristate "Hybrid Mount VFS Path Redirection Subsystem"
	default y
	help
	  Hybrid Mount's VFS path redirection subsystem. It injects, hides and
	  redirects paths without mounting filesystems, and is driven by the Hybrid
	  Mount metamodule over the keyring. It is not compatible with NoMount's
	  metamodule or its tooling.
```
